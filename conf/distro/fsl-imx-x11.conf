## conf/distro/fsl-imx-x11.conf
```bitbake
# i.MX DISTRO for X11 with no wayland

include conf/distro/include/fsl-imx-base.inc
include conf/distro/include/fsl-imx-preferred-env.inc

DISTRO = "fsl-imx-x11"

# Remove conflicting backends.
DISTRO_FEATURES_remove = "wayland"

# These are X11 specific
DISTRO_FEATURES_append = " x11"

# DISTRO_FEATURES_append = " systemd"
# VIRTUAL-RUNTIME_init_manager = "systemd"
# DISTRO_FEATURES_BACKFILL_CONSIDERED = "sysvinit"
# VIRTUAL-RUNTIME_initscripts = ""


MIRRORS ??= "\
sftp://.*/.* http://downloads.yoctoproject.org/mirror/sources/ \n \
ssh://.*/.* http://downloads.yoctoproject.org/mirror/sources/ \n \
ftp://.*/.* http://downloads.yoctoproject.org/mirror/sources/ \n \
http://.*/.* http://downloads.yoctoproject.org/mirror/sources/ \n \
https://.*/.* http://downloads.yoctoproject.org/mirror/sources/ \n \
bzr://.*/.* http://downloads.yoctoproject.org/mirror/sources/ \n \
cvs://.*/.* http://downloads.yoctoproject.org/mirror/sources/ \n \
git://.*/.* http://downloads.yoctoproject.org/mirror/sources/ \n \
gitsm://.*/.* http://downloads.yoctoproject.org/mirror/sources/ \n \
hg://.*/.* http://downloads.yoctoproject.org/mirror/sources/ \n \
osc://.*/.* http://downloads.yoctoproject.org/mirror/sources/ \n \
p4://.*/.* http://downloads.yoctoproject.org/mirror/sources/ \n \
svn://.*/.* http://downloads.yoctoproject.org/mirror/sources/ \n"

# BB_NO_NETWORK = "1"
# BB_FETCH_PREMIRRORONLY = "1"
```

## conf/layer.conf
```bitbake
# We have a conf and classes directory, add to BBPATH
BBPATH .= ":${LAYERDIR}"

# We have a packages directory, add to BBFILES
BBFILES += "${LAYERDIR}/recipes-*/*/*.bb \
            ${LAYERDIR}/recipes-*/*/*.bbappend"

BBFILE_COLLECTIONS += "advantech-arm-extra"
BBFILE_PATTERN_advantech-arm-extra := "^${LAYERDIR}/"
BBFILE_PRIORITY_advantech-arm-extra = "9"

LAYERDEPENDS_advantech-arm-extra = "core fsl-arm fsl-arm-extra"
```

## conf/machine/imx6dl-dmsse23.conf
```bitbake
#@TYPE: Machine
#@NAME: Advantech DMS-SE23
#@SOC: i.MX6Q
#@DESCRIPTION: Machine configuration for Advantech DMS-SE23 board

include conf/machine/include/imx-base.inc
include conf/machine/include/tune-cortexa9.inc

SOC_FAMILY = "mx6:mx6dl"

SERIAL_CONSOLE = "115200 ttymxc0"

PREFERRED_PROVIDER_virtual/bootloader = "u-boot-imx"
PREFERRED_PROVIDER_u-boot = "u-boot-imx"
UBOOT_MACHINE = "mx6dldmsse23_defconfig"

PREFERRED_PROVIDER_virtual/kernel = "linux-imx"
PREFERRED_PROVIDER_kernel = "linux-imx"
KERNEL_DEVICETREE = "imx6dl-dmsse23.dtb"
```
